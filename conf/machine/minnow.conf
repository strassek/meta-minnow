## conf/machine/minnow.conf
```bitbake
#@TYPE: Machine
#@NAME: minnow

#@WEBTITLE: Intel Atom E640T Processor with Intel EG20T Controller Hub Development Kit (Queens Bay) with Proprietary IEMGD Accelerated Graphics.

#@DESCRIPTION: Machine configuration for the Minnow Board systems

require conf/machine/include/tune-atom.inc
require conf/machine/include/ia32-base.inc
require conf/machine/include/meta-intel.inc

# Some of the EMGD components have dependency on libx11.
# Add these only when Xserver is enabled with the EMGD driver
# Otherwise unwanted X components will start showing up in the non-X images
VA_FEATURES ?= "gst-va-intel va-intel"

MACHINE_FEATURES += "efi va-impl-mixvideo"
MACHINE_EXTRA_RRECOMMENDS += "${VA_FEATURES}"

PREFERRED_PROVIDER_virtual/kernel ?= "linux-yocto"
PREFERRED_VERSION_linux-yocto = "3.8%"

XSERVER ?= "${XSERVER_IA32_BASE} \
            ${XSERVER_IA32_EXT} \
            ${XSERVER_IA32_EMGD} \
           "

PREFERRED_VERSION_xserver-xorg ?= "1.9.3"
PREFERRED_VERSION_mesa-dri ?= "8.0.4"
PREFERRED_VERSION_xf86-input-evdev ?= "2.6.0"
PREFERRED_VERSION_emgd-driver-bin ?= "1.16"

APPEND += "console=ttyPCH0,115200 console=tty0 vmalloc=256MB"
SERIAL_CONSOLE = "115200 ttyPCH0"

MACHINE_EXTRA_RRECOMMENDS += "${VA_FEATURES}"
```
